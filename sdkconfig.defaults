## sdkconfig.defaults
```kconfig
# Bluetooth configuration
CONFIG_BT_ENABLED=y
CONFIG_BT_BLUEDROID_ENABLED=y
CONFIG_BT_CLASSIC_ENABLED=y
CONFIG_BT_A2DP_ENABLE=y
CONFIG_BT_SPP_ENABLED=y

# WiFi configuration
CONFIG_ESP_WIFI_SOFTAP_SUPPORT=y

# HTTP server configuration
CONFIG_HTTPD_MAX_REQ_HDR_LEN=1024
CONFIG_HTTPD_MAX_URI_LEN=512

# FreeRTOS configuration
CONFIG_FREERTOS_HZ=1000

# Flash size - 4MB
CONFIG_ESPTOOLPY_FLASHSIZE_4MB=y

# Partition table - use custom partition table
CONFIG_PARTITION_TABLE_CUSTOM=y
CONFIG_PARTITION_TABLE_SINGLE_APP=n
CONFIG_PARTITION_TABLE_CUSTOM_FILENAME="partitions.csv"
CONFIG_PARTITION_TABLE_FILENAME="partitions.csv"
```
